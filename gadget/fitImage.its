## gadget/fitImage.its
```
/dts-v1/;
  
/ {
    description = "Configuration to load OpenSBI before U-Boot";
    images {
        uboot {
            description = "U-Boot";
            data = /incbin/("parts/u-boot-smode/build/u-boot-nodtb.bin");
            type = "standalone";
            arch = "riscv";
            os = "U-Boot";
            compression = "none";
            load = <0x81200000>;
        };
        opensbi {
            description = "RISC-V OpenSBI";
            data = /incbin/("parts/opensbi/build/build/platform/generic/firmware/fw_dynamic.bin");
            type = "firmware";
            os = "opensbi";
            arch = "riscv";
            compression = "none";
            load = <0x81000000>;
            entry = <0x81000000>;
        };
    };
    configurations {
        default = "conf_1";
        conf_1 {
            description = "Boot Linux kernel with U-Boot & OpenSBI";
            firmware = "opensbi";
            loadables = "uboot";
        };
    };
};
```
